## CMakeLists.txt
```
# SPDX-License-Identifier: Apache-2.0

cmake_minimum_required(VERSION 3.20.0)

find_package(Zephyr REQUIRED HINTS $ENV{ZEPHYR_BASE})
project(zephyr-rail)

FILE(GLOB app_sources src/*.cpp)

target_sources(app PRIVATE ${app_sources})
```

## Kconfig
```
# SPDX-License-Identifier: Apache-2.0

source "Kconfig.zephyr"

rsource "../lib/stepper_with_target/Kconfig"
```

## west.yml
```
# Auto-generated by init.sh, Do not edit!
manifest:
  defaults:
    remote: zephyrproject-rtos
  remotes:
    - name: zephyrproject-rtos
      url-base: https://github.com/zephyrproject-rtos
  projects:
    - name: zephyr
      remote: zephyrproject-rtos
      revision: v4.3.0 # generated from flake.nix
      clone-depth: 1
      import: true
  self:
    path: app
```

## prj.conf
```kconfig
CONFIG_LOG=y
CONFIG_CONSOLE=y
CONFIG_SERIAL=y
```

## src/main.cpp
```c
#include <zephyr/kernel.h>
#include <zephyr/logging/log.h>

LOG_MODULE_REGISTER(main, LOG_LEVEL_INF);

int main(void) {
  LOG_INF("Hello World");

  while (1) {
    k_msleep(1000);
  }

  return 0;
}
```
